## drivers/media/platform/msm/Kconfig
```kconfig
source "drivers/media/platform/msm/vidc/Kconfig"

#
# MSM camera configuration
#

comment "Qualcomm MSM Camera And Video"

menuconfig MSM_CAMERA
	bool "Qualcomm MSM camera and video capture support"
	depends on ARCH_MSM && VIDEO_V4L2 && I2C
	---help---
	  Say Y here to enable selecting the video adapters for
	  Qualcomm msm camera and video capture drivers. enabling this
	  adds support for the camera driver stack including sensor, isp
	  and postprocessing drivers for legacy chipsets.

config MSM_CAMERA_DEBUG
	bool "Qualcomm MSM camera debugging with printk"
	depends on MSM_CAMERA
	default n
	---help---
	  Enable printk() debug for msm camera

config MSM_CAMERA_AUTOMOTIVE
	bool "Qualcomm MSM camera for automotive support"
	depends on MSM_CAMERA
	default n
	---help---
	  Enables support for automotive targets

menuconfig MSMB_CAMERA
	bool "Qualcomm MSM camera and video capture 2.0 support"
	depends on ARCH_MSM && VIDEO_V4L2 && I2C
	---help---
	  Say Y here to enable selecting the video adapters for
	  Qualcomm msm camera and video capture 2.0, enabling this
	  adds support for the camera driver stack including sensor, isp
	  and postprocessing drivers.

config MSMB_CAMERA_DEBUG
	bool "Qualcomm MSM camera 2.0 debugging with printk"
	depends on MSMB_CAMERA
	---help---
	  Enable printk() debug for msm camera 2.0

choice
        prompt "Camera stack variant"
        depends on MSMB_CAMERA && MACH_LEECO
        default MSMB_CAMERA_DEFAULT

config MSMB_CAMERA_DEFAULT
	bool "Default Qualcomm camera stack"

config LETV_CAMERA
	bool "LETV's variant of the camera stack"
	---help---
	  Enable the older M-based LETV camera code

endchoice

if MSMB_CAMERA
if MSMB_CAMERA_DEFAULT
source "drivers/media/platform/msm/camera_v2/Kconfig"
endif # if MSMB_CAMERA_DEFAULT
if LETV_CAMERA
source "drivers/media/platform/msm/camera_v2_letv/Kconfig"
endif
endif
source "drivers/media/platform/msm/dvb/Kconfig"
source "drivers/media/platform/msm/broadcast/Kconfig"
source "drivers/media/platform/msm/sde/Kconfig"
```
